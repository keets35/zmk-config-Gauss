#include <behaviors.dtsi>
#include <dt-bindings/zmk/keys.h>

&left_encoder { status = "okay"; };

#define DEFAULT 0

/ {
    keymap {
        compatible = "zmk,keymap";

        default_layer {
            bindings = <
&kp C_MUTE  &kp C_PREV  &kp C_PLAY_PAUSE  &kp C_NEXT
            >;

            sensor-bindings = <&inc_dec_kp C_VOLUME_DOWN C_VOLUME_UP>;
        };
    };
};
