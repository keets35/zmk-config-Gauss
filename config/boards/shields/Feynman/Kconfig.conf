## config/boards/shields/Feynman/Kconfig.conf
```kconfig
if SHIELD_FEYNMAN

config  ZMK_KEYBOARD_NAME
    default "Feynman"

endif

# Enable nice!view
CONFIG_ZMK_DISPLAY=y
# Disable idle blanking
CONFIG_ZMK_DISPLAY_BLANK_ON_IDLE=n
```

## config/boards/shields/Feynman/Kconfig.shield
```kconfig
config SHIELD_FEYNMAN
    def_bool $(shields_list_contains,Feynman)

config SYSTEM_WORKQUEUE_STACK_SIZE
	int "work queue stack size"
  default 4096

config CONFIG_MAIN_STACK_SIZE
	int "main stack size"
  default 2048
```

## config/boards/shields/Gauss/Kconfig.shield
```kconfig
config SHIELD_GAUSS
    def_bool $(shields_list_contains,GAUSS)

config SYSTEM_WORKQUEUE_STACK_SIZE
	int "work queue stack size"
  default 4096

config CONFIG_MAIN_STACK_SIZE
	int "main stack size"
  default 2048
```
